/*
 * Copyright (c) 2020 The ZMK Contributors
 *
 * SPDX-License-Identifier: MIT
 */

/ {
	behaviors {
		kpc: behavior_key_press_cleared {
			compatible = "zmk,behavior-key-press-clearmod";
			label = "KEY_PRESS_CLEARED";
			#binding-cells = <1>;
		};
	};
};
